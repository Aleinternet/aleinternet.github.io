/******************************************************************
 * SparkFun Inventor's Kit
 * Example sketch 03 -- RGB LED + Drawdio Sound Modification
 * 
 * Make an RGB LED display a rainbow of colors and modify the sound
 * generated by the Drawdio circuit based on a potentiometer value!
 *  
 * This sketch was written by SparkFun Electronics,
 * with lots of help from the Arduino community.
 * Visit http://learn.sparkfun.com/products/2 for SIK information.
 * Visit http://www.arduino.cc to learn about the Arduino.
 * 
 * Version 2.0 6/2012 MDG
 * Version 2.1 9/2014 BCH
 *****************************************************************/
const int RED_PIN = 9;
const int GREEN_PIN = 10;
const int BLUE_PIN = 11;
const int POT_PIN = A0; // Pin del potenciómetro
const int SPEAKER_PIN = 3; // Pin de salida del parlante

const int DISPLAY_TIME = 200;  // used in mainColors() to determine the 
// length of time each color is displayed.

void setup() {
  pinMode(RED_PIN, OUTPUT);
  pinMode(GREEN_PIN, OUTPUT);
  pinMode(BLUE_PIN, OUTPUT);
  pinMode(SPEAKER_PIN, OUTPUT);

  Serial.begin(9600);
}

void loop() {
  int potValue = analogRead(POT_PIN);

  // Controlar el color del LED RGB
  if (potValue < 341) {
    analogWrite(RED_PIN, 0);
    analogWrite(GREEN_PIN, 0);
    analogWrite(BLUE_PIN, 255);
  } else if ((potValue > 342) and (potValue < 682)) {
    analogWrite(RED_PIN, 0);
    analogWrite(GREEN_PIN, 255);
    analogWrite(BLUE_PIN, 0);
  } else if (potValue > 682) {
    analogWrite(RED_PIN, 255);
    analogWrite(GREEN_PIN, 0);
    analogWrite(BLUE_PIN, 0);
  }

  // Controlar el sonido del Drawdio modificando la frecuencia del tono
  int frequency = map(potValue, 0, 1023, 100, 10000);
  tone(SPEAKER_PIN, frequency);

  Serial.println(potValue);

  delay(10);
}
